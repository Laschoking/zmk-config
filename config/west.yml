## config/west.yml
```yaml
manifest:
  defaults:
    revision: v0.3
  remotes:
    - name: zmkfirmware
      url-base: https://github.com/zmkfirmware
    - name: bildermankawasaki
      url-base: https://github.com/bildermankawasaki
    # Additional modules containing boards/shields/custom code can be listed here as well
    # See https://docs.zephyrproject.org/3.2.0/develop/west/manifest.html#projects
  projects:
    - name: zmk
      remote: zmkfirmware
      import: app/west.yml
    - name: totem
      remote: bildermankawasaki
      url: https://github.com/BildermanKawasaki/zmk-keyboard-TOTEM
      revision: main
      path: modules/zmk-keyboard-TOTEM
  self:
    path: config
```
